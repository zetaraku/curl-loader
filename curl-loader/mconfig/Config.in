## curl-loader/mconfig/Config.in
```kconfig
mainmenu "User Configuration"

menu "General Section"


config BATCH_NAME
	string " Batch Name"
	default user_batch
	help
            Batch is a group of clients with the same characteristics and 
            loading behavior. We recommend you to use unique names for your 
            batches, because logfiles and statistics files names are derived
            from the batch name + extension.

config CLIENTS_NUM_MAX
	int " Virtual Clients Maximum Number"
	default 1
	range 1 32000
	help
	  Number of virtual clients used for loading. This is the maximum number
            to be used. You may wish to start with a lower number and gradually 
            increase you load. This is the place, where the next option "Virtual Clients 
            Number Increment at Startup" comes to your assistance.

config CLIENTS_NUM_START
	int " Virtual Clients Number for Start"
	default 0
	range 0 10000
	help
	  Number of virtual clients used for loading start. When zero and 
            "Virtual Clients Number Increment at Startup" is not, the later
            is taken as the number to start. When both numbers zero, 
            CLIENTS_NUM_MAX all clients will be used from the very
            beginning of the load.

config CLIENTS_RAMPUP_INC
	int " Virtual Clients Number Rampup at Startup"
	default 0
	range 0 200
	help
	  Specify the number of loading clients to be added each second till the 
            total clients number reaches the number, specified by CLIENTS_NUM_MAX,
            starting from CLIENTS_NUM_START.
            When this number is zero and CLIENTS_NUM_START is also zero mean, 
            that use for loading CLIENTS_NUM_MAX from the very beginning, 
            instead of gradual increase of clients number at loading start.

config INTERFACE
	string " Network Interface for Loading"
	default "eth0"
	help
            Name of the network interface to be used for loading. Run "/sbin/ifconfig" or 
            "ip addr" to figure out the interfaces, that you have.

config IP_ADDR_MIN
	string " Minimal Address of the IP-Range for Loading"
	default "192.168.0.1"
	help
            To run loading you should choose a range of IP-addresses to be used
            by the virtual clients. Pass quad-dotted IPv4 string with the minimal 
            address here. Please, mind that number of IP-addresses in the range 
            (Max - Min) should be equal or more, than the "Virtual Clients Number".
            Thus, every virtual client will have its own IP-address to be used 
            for loading.
            However, when IP_ADDR_MIN address is equal to IP_ADDR_MAX, 
            it signals to the loader to use the same IP-address for all clients.

config IP_ADDR_MAX
	string " Maximum Address of the IP-Range for Loading"
	default "192.168.0.2"
	help
            To run loading you should choose a range of IP-addresses to be used
            by the virtual clients. Pass quad-dotted IPv4 string with the maximal 
            address here. Please, mind that number of IP-addresses in the range 
            (Max - Min) should be equal or more, than the "Virtual Clients Number".
            Thus, every virtual client will have its own IP-address to be used 
            for loading.
            However, when IP_ADDR_MIN address is equal to IP_ADDR_MAX, 
            it signals to the loader to use the same IP-address for all clients.

config NETMASK
	string " Netmask of the IP-Range for Loading"
	default "255.255.255.0"
	help
            Ether quad-dotted IPv4 string or number in CIDR notation.

config CYCLES_NUM
	int " Loading Virtual Clients Number"
	default -1
	range -1 10000000
	help
	  Number of loading cycles. (-1) means run load indefinetely (but you can stop
            running your load at any time by Control-C). Zero means don't run (Is it really 
            useful for a loader not to load?).

config USER_AGENT
	string " User Agent Header Value"
          default ""
	help
            If not specified, we are taking the default MSIE Explorer 6 string. 
            Skip it if it is OK for you, or if it is not applicable, e.g. FTP.

config URLS_NUM
	int "Number of URLs"
	default 1
	range 1 100
	help
	  Number of urls to be used for fetching url, sleeping, 
            fetchng another url, etc

endmenu


menu "URL Main"

config URL
	string " URL"
	default ""
	help
            Really URL. It could be an empty string, but not
            for the first URL

config URL_SHORT_NAME
	string " URL Short Name"
	default ""
          depends on URL
	help
            An optional up to 12 charachers custome short name.
comment " URL Short Name - support disabled"
	depends on !URL

config REQUEST_TYPE
	string " Request Type"
	default "GET"
          depends on URL
	help
            For HTTP supported GET, POST and PUT.
comment " Request Type - support disabled"
	depends on !URL

config TIMER_URL_COMPLETION
	int " Timer URL Completion"
	default 0
	range 0 200000
          depends on URL
	help
            When a value of the tag is above 0, we are monitoring the url-fetching 
            and cancelling it, if above the specified milliseconds.
           The results are presented on the Load Status GUI as the operation 
           Timeouted statistics and is reflected in files as T-Err number.
comment " Timer URL Completion - support disabled"
	depends on !URL

config TIMER_AFTER_URL_SLEEP
	int " Timer of after URL sleeping"
	default 0
	range 0 3600000
          depends on URL
	help
	  The time in milliseconds for client to sleep after fetching a URL prior to the 
            next URL to do. Zero (0) means don't wait and schedule client after 
            the URL immediately.
comment " Timer URL Completion - support disabled"
	depends on !URL

endmenu



menu "URL User Authentication"

config USERNAME
	string " Username"
	default ""
	help
            URL username string. If you do not need to configure username,
            leave it empty.
            
config PASSWORD
	string " Password"
	help
            URL password string, when required. Leave it empty, when no
            need.

config FORM_RECORDS_FILE
	string " Form Records (Credentials) File"
	default ""
          depends on LOGIN
	help
             Fullpath to the credentials file containing credentials lines formatted as 
             userSEPARATORpassword without spaces left. 
             We are supporting separators ':', '@', '/' and ' ' (space), which according to 
             RFC1738 are safe to use between username and password. Only one of the 
             above separators to be used in each file. Note, that when the file with credentials 
             is specified, "Login POST String Matrix" should not contain %d symbols and to 
             be something like  "user=%s&password=%s"

comment "Form Records (Credentials) File - support disabled"
	depends on !URL

config FORM_USAGE_TYPE
	string " Form String - see help"
	default ""
          depends on URL
	help

config FORM_STRING
	string " Form String - see help"
	default "username=%s%d&password=%s%d"
          depends on FORM_USAGE_TYPE
	help
            To generate multiple unique users with unique passwords, use the string like
            "username=%s%d&password=%s%d". First '%s' will be substituted by the 
            value of LOGIN_URL_USERNAME tag and '%d' by the client number. Second '%s' will
            be substituted by LOGIN_URL_PASSWORD tag value and second '%d' by the same client
            number. For example, if LOGIN_URL_USERNAME=robert, LOGIN_URL_PASSWORD=stam
            and LOGIN_POST_STR "username=%s%d&password=%s%d", the final POST string, 
            used for the client number 1, will be  "username=robert1&password=stam1".

            In this case USERNAME and PASSWORD strings are used just 
            as base-words for generating unique user credentials by appending an number.
            To use the username and password 'as as', just provide POST_STRING without 
            %d symbols, e.g. "user=%s&secret=%s". Thus, all clients will have the same
            POST credentials with the string looking like "user=robert&secret=stam". 

            The option without %d symbols to be used also, when "Form Records (Credentials) 
            File" is defined, because the credentials uniqueness is ensured by the file content.

            Another valid option supported is to generate unique users with the same password,
            using template like this: "username=%s%d&password=%s"
            
comment "Form String - support disabled"
	depends on !FORM_USAGE_TYPE

endmenu


menu "URL Fetch Customization"

config HEADER
	string " Custom Header"
          default ""
	help
            Provide your own header using the correct RFC syntax, e.g. "Connection: close".
            Note, that providing the header, which already exist in libcurl, overwrites the
            libcurl defaults. 
            Use ethereal/wireshark to figure out, what are the current headers used by the loader.
            You can specify as much HEADER-s , as you wish, but outside
            of the 'make menuconfig' system. Just copy the configuration file out and add to
            the appropriate url a number of HEADER tags with values.

endmenu
```
